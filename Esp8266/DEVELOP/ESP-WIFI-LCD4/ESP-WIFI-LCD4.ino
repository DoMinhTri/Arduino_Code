//#include "ShiftLCD.h"
#include "LCD3Wire.h"
// initialize the library with the numbers of the interface pins

#include <ESP8266WiFi.h>
#include <EEPROM.h>
#include "Arduino.h"
//#include <SPI.h>

//////////////////////
// WiFi Definitions //
//////////////////////
const char WiFiAPPSK[] = "sparkfun";
const int led = 2;
const char* ssid = "robson";
// char ssid[] = "Benjamin";
//const char* ssid = "physics_dept";
//const char* password = "4522641400abc";
// char* password = "abcde";
//const char* password = "2530172014";
/////////////////////
// Pin Definitions //
/////////////////////
const int LED_PIN = 2; // Thing's onboard, green LED
const int ANALOG_PIN = A0; // The only analog pin on the Thing
const int DIGITAL_PIN = 12; // Digital pin to be read
const int DIGITAL_PIN1 = 2;
//LCD3Wire lcd = LCD3Wire(2, 13, 4,14); 
LCD3Wire lcd = LCD3Wire(2, 14,16,13); 
//LCD3Wire lcd = LCD3Wire(2, serial data,latch,clock);
//ShiftLCD lcd(13, 14, 4);

 const char IN[ ]= {
 0x3C,0x21,0x44,0x4F,0x43,0x54,0x59,0x50,0x45,0x20,0x68,0x74,0x6D,0x6C,0x3E,0x0D,
  0x0A,0x3C,0x68,0x74,0x6D,0x6C,0x3E,0x3C,0x68,0x65,0x61,0x64,0x3E,0x3C,0x6D,0x65,
  0x74,0x61,0x20,0x68,0x74,0x74,0x70,0x2D,0x65,0x71,0x75,0x69,0x76,0x3D,0x22,0x43,
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  0x68,0x74,0x6D,0x6C,0x3E};
const char image[] = {
0xff, 0xd8, 0xff, 0xe0, 00, 0x10, 0x4a, 0x46, 0x49, 0x46, 00, 0x1, 0x1, 00, 00, 0x1, 
00, 0x1, 00, 00, 0xff, 0xdb, 00, 0x84, 00, 0x9, 0x6, 0x6, 0x8, 0x6, 0x5, 0x14, 
0x13, 0x7, 0x8, 0x16, 0x15, 0x14, 0x13, 0x19, 0x1c, 0x19, 0x17, 0x17, 0x17, 0x17, 0x1e, 0x1c, 
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0x04, 0xff, 0xff, 0xff
};
const char ES[]  = {
            0xFF,0xD8,0xFF,0xE0,0x00,0x10,0x4A,0x46,0x49,0x46,0x00,0x01,0x01,0x01,0x00,0x48,
    0x00,0x48,0x00,0x00,0xFF,0xDB,0x00,0x43,0x00,0x06,0x04,0x05,0x06,0x05,0x04,0x06,
    0x06,0x05,0x06,0x07,0x07,0x06,0x08,0x0A,0x10,0x0A,0x0A,0x09,0x09,0x0A,0x14,0x0E,
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    0xA5,0x51,0x2A,0x4B,0xFF,0xD9
            };


WiFiServer server(80);
IPAddress sa{0,0,0,0};
void setup() 
{
  initHardware();
  setupWiFi();
  server.begin();
}

void loop() 
{
  // Check if a client has connected
  WiFiClient client = server.available();
  if (!client) {
    return;
  }

  // Read the first line of the request
  String req = client.readStringUntil('\r');
  Serial.println(req);
  client.flush();
  
  // Match the request
  int val = -1; // We'll use 'val' to keep track of both the
                // request type (read/set) and value if set.
  if (req.indexOf("/0?0=LEDOFF") != -1)
    val = 0; // Will write LED low
  else if (req.indexOf("/0?1=LEDON") != -1)
    val = 1; // Will write LED high
  else if (req.indexOf("Status.cgi") != -1)
    val = -2; // Will print pin reads
   else if (req.indexOf("READ") != -1)
    val = -2; // Will print pin reads
   else if (req.indexOf("/IB") != -1)
   val =-3;
   else if (req.indexOf("/ES") != -1)
   val =-4;
  //  val = -2; // Will print pin reads
  // Otherwise request will be invalid. We'll say as much in HTML

  // Set GPIO5 according to the request
  if (val >= 0)
    digitalWrite(LED_PIN, val);
  
  client.flush(); 


   if (val == -3)
  { // If we're reading pins, print out those values:
   String s1 = "HTTP/1.1 200 OK\r\n";
    s1 += "Content-Type: image/jpeg\r\n\r\n"; 
   client.print(s1);
   client.write(image, sizeof(image));
   goto s;
  }
 else  if (val == -4)
  { // If we're reading pins, print out those values:
   String s3 = "HTTP/1.1 200 OK\r\n";
    s3 += "Content-Type: image/jpeg\r\n\r\n"; 
   client.print(s3);
  // client.write(ES, sizeof(ES));
  sendProgmem(client,ES,sizeof(ES));  // add these lines
   goto s;
  }

  else  if (val == -2)
  { // If we're reading pins, print out those values:
    String s2 = "HTTP/1.1 200 OK\r\n";
     s2 += "Content-Type: text/html\r\n\r\n";
      s2 += "<br> Temperature = ";  
     s2 += String(analogRead(ANALOG_PIN)*1000/1023/10);
     s2 +="   Degree C";
    s2 += "<br>"; // Go to the next line.
    s2 += "GPIO Pin State 12 = ";
    s2 += String(digitalRead(DIGITAL_PIN));
    s2 += "<br>"; // Go to the next line.
    s2 += "LED State = ";
    s2 += String(digitalRead(DIGITAL_PIN1));
    client.print(s2);
    goto s;
  }
  else
  {
    String s3 = "HTTP/1.1 200 OK\r\n";
    s3 += "Content-Type: text/html\r\n\r\n";
    client.print(s3); 
   client.write(IN, sizeof(IN));  
    
  }

  s: delay(10);
  Serial.println("Client disonnected");

  // The client will actually be disconnected 
  // when the function returns and 'client' object is detroyed

}

void setupWiFi()
{
  int state =0;
  int i;
  char Response[20];
 // char Response1[20];
  char ch[20];
  char ch1[20];
  Serial.begin(115200);
// lcd.begin(16, 2);
 lcd.init();

//  InitSPI();
//  Lcd_Init();
//test_shift(0x53,1,1,1);
// LCD_init();
  Serial.println("");

  pinMode(led, OUTPUT);
 lcd.cursorTo(1, 0);  //line=2, x=0.
 lcd.print("ESP-WIFI");

//lcd.print("ESP8266 WIFI");
//  lcd.write(0x27);
//  LCD_Home();
//  LCD_sendchar('V');
 // LCD_send_string((const char*)"ESP8266 WIFI");
 // LCD_second_row();
//  LCD_send_string((const char*)"NOT CONNECTED");
   state = digitalRead(DIGITAL_PIN);
  if(state ==0){
    EEPROM.begin(512);
  // write a 0 to all 512 bytes of the EEPROM
  for (int i = 0; i < 512; i++)
    EEPROM.write(i, '\0');
     EEPROM.end();
     
    Serial.print("\r\n\r\n\rESP8266-WIFI Config Application \r\n\r\n");
    Serial.print("\t1: Change SSID-PASSWORD.\r\n");
    Serial.print("PL NOTE SSID AND PASSWORD IN ONE STRING SEPERATED BY COMMA\r\n");
    Serial.print("Please Enter SSID,PASSWORD  and press Enter\r\n");
    ReadStringUART(Response);
   // Serial.print("Enter Password  and press Enter\r\n");
   // ReadStringUART(Response1,sizeof(Response1));
    
    int addr =0;
    
    EEPROM.begin(512);
    i=0;
    while(1)
    {
     if(Response[i] == ',')
       goto p;
     EEPROM.write(addr,Response[i]);
      addr =addr+1;
      i=i+1;
    }
    
   //   EEPROM.commit();
      // password write
   // EEPROM.begin(512);
  p: EEPROM.write(addr,'\0');
     //i=0;
     i++;
    int addr2 =10;
    while(1)
    {
     if(Response[i] == '\0')
       break;
     EEPROM.write(addr2,Response[i]);
      addr2 =addr2+1;
      i=i+1;
    }
     EEPROM.commit();
     
  }
  EEPROM.begin(512);
  int addr1 =0;
  i=0;
  while(1){
   ch[i] = EEPROM.read(addr1);
   addr1 =addr1+1;
   if(ch[i]=='\0')
   break; 
   i=i+1;
  }
  //PASSWPRDread
   
  EEPROM.begin(512);
  int addr3 =10;
  i=0;
  while(1){
   ch1[i] = EEPROM.read(addr3);
   addr3 =addr3+1;
   if(ch1[i]=='\0')
   break; 
   i=i+1;
  }
  Serial.print("SSID IS   ");
  Serial.println(ch);
  Serial.print("PASSWORD IS  ");
  Serial.println(ch1);
  // n1= Serial.readStringUntil('/n');
//  Serial.print("Entered ssid  name2 is   ");
//  Serial.println(n);
 // Serial.write(n[0]);
  // Connect to WiFi network

  WiFi.begin(ch,ch1);

  

  // Wait for connection

  while (WiFi.status() != WL_CONNECTED) {

    delay(500);

    Serial.print(".");

  }
//   LCD_Home();
//  LCD_send_string((const char*)"CONNECTED");
//  LCD_second_row();
//  sa= WiFi.localIP();
 // sa.IPAddress();
 //const  char* ip =(const char*) sa.raw_address();
//  sa->IPAddress(ip);
// LCD_sendchar(sa[0]);
// LCD_sendchar(sa[1]);
// LCD_sendchar(sa[2]);
// LCD_sendchar(sa[3]);
 // LCD_send_string(ip);
//  Serial.println("");

//  Serial.print("Connected to ");

//  Serial.println(ch);

//  Serial.print("IP address: ");

  Serial.println(WiFi.localIP());  
 lcd.cursorTo(1, 0);
  lcd.print("IP ADDRESS: ");
  // Set up the endpoints for HTTP server
  lcd.cursorTo(2,0);
  lcd.println(WiFi.localIP()); 
}
void initHardware()
{
  Serial.begin(115200);
  pinMode(DIGITAL_PIN, INPUT_PULLUP);
  pinMode(LED_PIN, OUTPUT);
  digitalWrite(LED_PIN, LOW);
  // Don't need to set ANALOG_PIN as input, 
  // that's all it can be.
}

size_t sendProgmem(WiFiClient client, const char progmem[], size_t size) {
    size_t maxSize=2920; // this seems to be the max that write() will ever actually send
    size_t sent=0;

    while(sent < size) {
      size_t sendSize = (maxSize < (size - sent)) ? maxSize : (size - sent);
      sent += client.write(progmem+sent, sendSize); // write() may send less than you asked it to
    }
    return sent;
}

byte ReadStringUART(char *Dest)
{
  byte c;
  byte count = 0;

  while(1)
  {
    *Dest = '\0';

    while(!Serial.available());
    c = Serial.read();

    if(c == '\r' || c == '\n')
      break;

    count++;
    *Dest++ = c;
  }

  return count;
}

