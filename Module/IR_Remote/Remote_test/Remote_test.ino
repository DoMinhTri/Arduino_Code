#include <IRremote.h>
///////////////////
int led    = 10;
int pinIR  = 13;
int SoChon = 0;
boolean BatDauSuLy = false;
boolean LuuGiaTri  = false ;
IRrecv IRTrave(pinIR);
decode_results Trave;

int DayTinHieu[50] = {0,0,0,0,0,0,0,0,0,0,0,0,0,0,0,0,0,0,0,0,0,0,0,0,0,0,0,0,0,0,0,0,0,0,0,0,0,0,0,0,0,0,0,0,0,0,0,0,0,0} ;
int SoLan[50]      = {0,0,0,0,0,0,0,0,0,0,0,0,0,0,0,0,0,0,0,0,0,0,0,0,0,0,0,0,0,0,0,0,0,0,0,0,0,0,0,0,0,0,0,0,0,0,0,0,0,0} ;
///////////////////
void setup() 
{ 
   Serial.begin(9600);
   IRTrave.enableIRIn();
   pinMode(led, OUTPUT); 
} 
 
 
void loop() { 
  
 if (IRTrave.decode(&Trave)) 
 {
    int GT = Trave.value ;
    ChonNutRemote(GT);
    OnOffGhiTinHieu(GT);
    if(BatDauSuLy)
     { 
         if(GT!=-999) SuLyTinHieu(GT);
     }
    IRTrave.resume();
 }
 
} 
//-------------------------------------------------------------------
int NutPower[50] = { -1,10839,-7078,29434,5517,-30935,-11148,30321,-21431,2157,-21514,-32133,2901,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28751,11935};
void OnOffGhiTinHieu(int &TinHieu) 
{
   for(int i=0;i<50;i++)
  {
      if(TinHieu == NutPower[i]) 
      {
        NhayDenLed();
        BatDauSuLy = !BatDauSuLy;
        if(BatDauSuLy)
        {
            TinHieu=-999;  
            Serial.println("===[ Ghi tin hieu : On ]===");
        }
        else
            Serial.println("===[ Ghi tin hieu : Off ]===");
      }
   }
}
//-------------------------------------------------------------------
  char* TenNut[] = {"Power","Vol +","Vol -","CH +","Ch -","[1]","[2]","[3]","[4]","[5]","[6]","[7]","[8]","[9]","[+]","[0]","[-/--]","Time","Mute","Right","Down","Left","Up" ,"Null","Main menu","Pic menu","==== Show day tin hieu ===="};
  int MaSo[27]   = {101    ,11     ,22     ,33    ,44    ,1    ,2    ,3    ,4    ,5    ,6    ,7    ,8    ,9    ,111  ,222  ,333     ,444   ,555   ,1111   ,2222  ,3333  ,4444 ,5555  ,666        ,777       ,0                            };
  int DayTinHieuDK[50] = {28191,3628,-10310,-14709,-65,30933,18895,1498,-24198,18790,22695,32401,6894,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24708,7992 };
int ChonNutRemote(int TinHieu)
{
   for(int i=0;i<50;i++)
  {
    if(TinHieu == DayTinHieuDK[i])
    {
      NhayDenLed();
      SoChon = (SoChon + 1)%27;
      Serial.println("======================================");
      Serial.print("Ten nut : ");
      Serial.println(TenNut[SoChon]);
      Serial.print("Ma so   : ");
      Serial.println(MaSo[SoChon]);
      ///----- Xoa cac gia tri ghi neu co de ghi lai
      for(int j=0;j<50;j++)
      {
          DayTinHieu[j]=0;
          SoLan[j]=0;
       }
       ///////////////////////////////////////// Show day so nhap khi MaSo[SoChon] = 0
       if(MaSo[SoChon]==0) ShowDuLieuDay();
      break;
    }
  }
}
//-------------------------------------------------------------------

//-------------------------------------------------------------------
void NhayDenLed()
{
   digitalWrite(led, HIGH);  
   delay(100);               
   digitalWrite(led, LOW);   
   delay(100);               
}
//-------------------------------------------------------------------
void SuLyTinHieu(int TinHieu)
{
  int ViTri       = 0 ;
  int GiaTri      = 0 ;
  boolean TimThay = false ; 
  
  /////////////////////
  for(int i=0;i<50;i++)
  {
     ViTri  = i; 
     GiaTri = DayTinHieu[i] ;
     if(GiaTri == 0) break ;
     ////////////////////// 
     if(TinHieu == GiaTri) 
     {
       TimThay  = true ;
       break;
     }
  }
  /////////////////////
  if(TimThay)
  {
      SoLan[ViTri] = SoLan[ViTri] +1;
  }
  else
  {
      DayTinHieu[ViTri] = TinHieu ;
      SoLan[ViTri]      = 1;
  }
  /////////////////////
  int SoPhanTu=0;
  for(int j=0;j<50;j++)
  {
     if(SoLan[j] > 0)
     {
      SoPhanTu = j;
     } else {break;}
  }
  //-----------
    Serial.println("--------------------------------------------------------------------");  
    Serial.print("Ten nut : ");
    Serial.println(TenNut[SoChon]);
    Serial.print("So phan tu : ");
    Serial.println(SoPhanTu+1);
    Serial.print("@");
    for(int j=0;j<= SoPhanTu;j++)
    {
        Serial.print(DayTinHieu[j]);
        Serial.print(",");
    }
    //-----------
    Serial.println("");
    Serial.print("#");
    for(int k=0;k<= SoPhanTu;k++)
    {
        Serial.print(MaSo[SoChon]);
        Serial.print(",");
    }
    Serial.println(" ");
    if(SoPhanTu==49) 
     {
        BatDauSuLy = false;// Ngung su ly khi du so phan tu
        GhiDuLieuVaoDay();
        Serial.println("=========[ Ngung nhap tin hieu ]=========");
     }
    /////////////////////
}
//-------------------------------------------------------------------

int TinHieuFull[1300] = {0,0,0,0,0,0,0,0,0,0,0,0,0,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0,0} ;
int MaSoFull[1300]    = {0,0,0,0,0,0,0,0,0,0,0,0,0,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0,0} ;

void GhiDuLieuVaoDay()
{
  int tpViTri = -1;
  for(int j=0;j<50;j++)
  {
    tpViTri = SoChon*50 + j;
    TinHieuFull[tpViTri] = DayTinHieu[j];
    MaSoFull[tpViTri]    = MaSo[SoChon];
  }
}
//-------------------------------------------------------------------
void ShowDuLieuDay()
{
  Serial.println("");
  Serial.print("int TinHieuFull[1300] = {");
  for(int i=0;i<1300;i++)
  {
    Serial.print(","); 
    Serial.print(TinHieuFull[i]);
  }
   Serial.println("};");
  ///----------
  Serial.print("int MaSoFull[1300]    = {");
  for(int j=0;j<1300;j++)
  {
    Serial.print(","); 
    Serial.print(MaSoFull[j]);
  }
   Serial.println("};");
}

//-------------------------------------------------------------------
unsigned int Hex2Int(String hexString) {
  
  unsigned int decValue = 0;
  int nextInt;
  
  for (int i = 0; i < hexString.length(); i++) {
    
    nextInt = int(hexString.charAt(i));
    if (nextInt >= 48 && nextInt <= 57) nextInt = map(nextInt, 48, 57, 0, 9);
    if (nextInt >= 65 && nextInt <= 70) nextInt = map(nextInt, 65, 70, 10, 15);
    if (nextInt >= 97 && nextInt <= 102) nextInt = map(nextInt, 97, 102, 10, 15);
    nextInt = constrain(nextInt, 0, 15);
    
    decValue = (decValue * 16) + nextInt;
  }
  
  return decValue;
}

