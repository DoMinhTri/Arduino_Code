void setup()
{
  Serial.begin (115200);

}
////////////////////////////////////////////////////////////////////////////////////////////
////////////////////////////////////////////////////////////////////////////////////////////
////////////////////////////////////////////////////////////////////////////////////////////
////////////////////////////////////////////////////////////////////////////////////////////
String ChuoiDuLieu = "";

void loop() 
{
   ///////////////////////
   while (Serial.available() > 0 ) 
   {
        char KyTu = Serial.read();  uint8_t nbKyTu = (int)KyTu;  
        if( 31<nbKyTu && nbKyTu < 127 ){ ChuoiDuLieu+= KyTu; } delay(5);
   }
   ///////////////////////  
   if(ChuoiDuLieu != "")
   {
      SuLyGiaTriChuoiNhan(ChuoiDuLieu);
      ChuoiDuLieu = "";
   }
   /////////////////////// 
   delay(1000);
}
////////////////////////////////////////////////////////////////////////////////////////////
////////////////////////////////////////////////////////////////////////////////////////////
////////////////////////////////////////////////////////////////////////////////////////////
////////////////////////////////////////////////////////////////////////////////////////////
void SuLyGiaTriChuoiNhan(String ChuoiNhan)
{
  uint8_t nKyTu =  ChuoiNhan.length();
  String CDau   = ChuoiNhan.substring(0, 2);
  String CCuoi  = ChuoiNhan.substring(3, nKyTu);
  
  if(CDau == "WN")   {  Serial.print("Wifi name: "); Serial.print(CCuoi); }
  if(CDau == "WP")   {  Serial.print("Wifi pass: "); Serial.print(CCuoi); }

}
////////////////////////////////////////////////////////////////////////////////////////////
