////////////////////////////////////
uint8_t TuoiUuTien[4] = {0 , 0, 0, 0};
uint8_t SS1, SS2, SS3, SS4;
unsigned long ThoiDiemHienTai  = 0;
uint8_t NhietDo, SoThoiDiemHen = 0;
///////////////////////////////////////////
uint8_t giay, phut, gio, ngay, thang, nam, thu; 
String ThuTrongTuanEn[7] = {"Mon", "Tue", "Wed", "Thu", "Fri", "Sat", "Sun"};
String ThuTrongTuan[7]   = {"T2" , "T3" , "T4" , "T5" , "T6" , "T7" , "CN" };
///////////////////////////////////////////
#define PIN_RELAY1  16
#define PIN_RELAY2  14
#define PIN_RELAY3  12
#define PIN_RELAY4  13
//void RESTART(){ asm volatile ("  jmp 0"); }
//////////////////////////////////////////////////////////////////////////////////
//////////////////////////////////////////////////////////////////////////////////
/////////////////////      EEPROM      ///////////////////////////////////////////
//////////////////////////////////////////////////////////////////////////////////
//////////////////////////////////////////////////////////////////////////////////
#include <EEPROM.h>
void LuuEEPROM(int nDiaChi, uint8_t nGiaTri)
{
   EEPROM.write(nDiaChi, nGiaTri);
   EEPROM.commit();
   delay(20);
}
//////////////////////////////////////////////////////////////////////////////////
uint8_t LoadEEPROM(int nDiaChi){  delay(10);  return EEPROM.read(nDiaChi); }
//////////////////////////////////////////////////////////////////////////////////
void EEPROM_WC(int DiaChi, char KyTu){ EEPROM.write( DiaChi, KyTu );  delay(20);  }//Serial.print("Address: "); Serial.print(DiaChi); Serial.print(" - Char: "); Serial.println(KyTu); }
//////////////////////////////////////////////////////////////////////////////////
void EEPROM_WN(int DiaChi, uint8_t SoLuu){ LuuEEPROM(DiaChi, SoLuu); }
//////////////////////////////////////////////////////////////////////////////////
char EEPROM_RC(int DiaChi){ return (char)EEPROM.read(DiaChi); }
//////////////////////////////////////////////////////////////////////////////////
uint8_t EEPROM_RN(int DiaChi){ return EEPROM.read(DiaChi); }
//////////////////////////////////////////////////////////////////////////////////
void EEPROM_WS(int DiaChi, String ChuoiLuu)
{
  char* ChuoiTam = String2Char( ChuoiLuu );
  int DoDai  = ChuoiLuu.length();
  for (int i = 0; i < DoDai ; i++){ EEPROM_WC(DiaChi + i,ChuoiTam[i]); }
  delete ChuoiTam;
  EEPROM.commit();
}
//////////////////////////////////////////////////////////////////////////////////
String EEPROM_RS(int BatDau, int KetThuc)
{
    String ChuoiDoc = "";
    for(int i = BatDau; i< (BatDau + KetThuc); i++) { ChuoiDoc+= EEPROM_RC(i); }
    return ChuoiDoc;
}
//////////////////////////////////////////////////////////////////////////////////
void LuuVungDuLieu(int _BatDau, int _DoDai, String _ChuoiLuu)
{
  for(int i = _BatDau; i< _BatDau + _DoDai; i++){ EEPROM.write( i,255); delay(10); }
  EEPROM_WS(_BatDau, _ChuoiLuu);
}
//////////////////////////////////////////////////////////////////////////////////
String LoadVungDuLieu(int _BatDau, int _DoDai)
{
  String _strChuoi = "";
  for(int i = _BatDau; i< _BatDau + _DoDai; i++)
  { 
      char tmpChar = EEPROM_RC(i);
      if((tmpChar > 31) && (tmpChar < 127)){ _strChuoi+=  (String)tmpChar ; }
  }
  return _strChuoi;
}

////////////////////////////////////////////////////////////////////////////////// So luong thoi diem hen
uint8_t Load_SoLuongThoiDiemHen(){ return EEPROM_RN(30); }
//////////////////////////////////////////////////////////////////////////////////
void Luu_SoLuongThoiDiemHen(uint8_t nSoLuong){ EEPROM_WN(30, nSoLuong); };
//////////////////////////////////////////////////////////////////////////////////
void LayMangTongThoiGianHen()
{
  SoThoiDiemHen = Load_SoLuongThoiDiemHen();

}
//////////////////////////////////////////////////////////////////////////////////
//////////////////////////////////////////////////////////////////////////////////
//////////////////////////////////////////////////////////////////////////////////
//////////////////////////////////////////////////////////////////////////////////
/////////////////////      Text function      ////////////////////////////////////
//////////////////////////////////////////////////////////////////////////////////
//////////////////////////////////////////////////////////////////////////////////
//////////////////////////////////////////////////////////////////////////////////
char* String2Char(String Chuoi)
{
  char* ChuoiTam = new char[Chuoi.length() + 1];
  strcpy(ChuoiTam, Chuoi.c_str());
  return ChuoiTam;
}
//////////////////////////////////////////////////////////////////////////////////
int String2Int(String sSo){  return sSo.toInt();}
//////////////////////////////////////////////////////////////////////////////////
String SoKhongDau(uint8_t sSo){  
     if(sSo >9){  return String(sSo); }
     else{ return ("0" + String(sSo)); }
}
//////////////////////////////////////////////////////////////////////////////////
String TrangThaiTuoi(uint8_t sSo)
{
   if(sSo == 0) { return " "; }
   else{ if(ThoiDiemHienTai%2==0){ return "."; }else{ return ":"; } }
} 
//////////////////////////////////////////////////////////////////////////////////
//////////////////////////////////////////////////////////////////////////////////
//////////////////////////////////////////////////////////////////////////////////
//////////////////////////////////////////////////////////////////////////////////
//////////////////////////////////////////////////////////////////////////////////

void setup() 
{
   Serial.begin(9600);
   ////////////////
   pinMode(PIN_RELAY1, OUTPUT);
   pinMode(PIN_RELAY2, OUTPUT);
   pinMode(PIN_RELAY3, OUTPUT);
   pinMode(PIN_RELAY4, OUTPUT);
   ////////////////
   ////////////////
}
//////////////////////////////////////////////////////////////////////////////
String ChuoiData = "";
void loop() 
{
  ThoiDiemHienTai = millis()/1000;
  DongMoRelay();
  /////////////
  
}
//////////////////////////////////////////////////////////////////////////////////
void DongMoRelay()
{
  digitalWrite(PIN_RELAY1, HIGH);
  digitalWrite(PIN_RELAY2, HIGH);
  digitalWrite(PIN_RELAY3, HIGH);
  digitalWrite(PIN_RELAY4, HIGH);
  delay(2000);
  digitalWrite(PIN_RELAY1, LOW);
  digitalWrite(PIN_RELAY2, LOW);
  digitalWrite(PIN_RELAY3, LOW);
  digitalWrite(PIN_RELAY4, LOW);
  delay(1000);
}
//////////////////////////////////////////////////////////////////////////////////
//////////////////////////////////////////////////////////////////////////////////
